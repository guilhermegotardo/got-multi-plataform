## layers/meta-got/conf/distro/got.conf
```bitbake
require conf/distro/poky.conf

DISTRO = "got"

DISTRO_NAME = "Gothardt"
DISTRO_VERSION = "1.0"
DISTRO_CODENAME = "got"

MAINTAINER = "GOT Project"

INIT_MANAGER = "systemd"

PACKAGE_CLASSES = "package_rpm"

DISTRO_FEATURES:append = " systemd usrmerge"
```
